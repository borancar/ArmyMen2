/* Generated by tools/placement.py -- do not edit. */
SECTIONS {
  .origdat 0x0046F000 : SUBALIGN(1) {
    KEEP(*(.rodata.am2_iat)) KEEP(*(.data.am2_iat))
    KEEP(*(.origdat.c000))
    KEEP(*(.rodata.am2_f_one)) KEEP(*(.data.am2_f_one))
    KEEP(*(.rodata.am2_f_one_hundredth)) KEEP(*(.data.am2_f_one_hundredth))
    KEEP(*(.rodata.am2_weapon_range_hi)) KEEP(*(.data.am2_weapon_range_hi))
    KEEP(*(.rodata.am2_weapon_range_lo)) KEEP(*(.data.am2_weapon_range_lo))
    KEEP(*(.rodata.am2_weapon_range_k3)) KEEP(*(.data.am2_weapon_range_k3))
    KEEP(*(.rodata.am2_sight_range_want)) KEEP(*(.data.am2_sight_range_want))
    KEEP(*(.origdat.c001))
    KEEP(*(.rodata.am2_iid_directdraw2)) KEEP(*(.data.am2_iid_directdraw2))
    KEEP(*(.origdat.c002))
    KEEP(*(.rodata.am2_iid_ds3d_listener)) KEEP(*(.data.am2_iid_ds3d_listener))
    KEEP(*(.origdat.c003))
    KEEP(*(.rodata.am2_guid_sys_mouse)) KEEP(*(.data.am2_guid_sys_mouse))
    KEEP(*(.rodata.am2_guid_sys_keyboard)) KEEP(*(.data.am2_guid_sys_keyboard))
    KEEP(*(.origdat.c004))
    KEEP(*(.rodata.am2_iid_directplay4a)) KEEP(*(.data.am2_iid_directplay4a))
    KEEP(*(.rodata.am2_clsid_directplay)) KEEP(*(.data.am2_clsid_directplay))
    KEEP(*(.origdat.c005))
    KEEP(*(.rodata.am2_iid_dplay_lobby3a)) KEEP(*(.data.am2_iid_dplay_lobby3a))
    KEEP(*(.rodata.am2_clsid_dplay_lobby)) KEEP(*(.data.am2_clsid_dplay_lobby))
    KEEP(*(.origdat.c006))
    KEEP(*(.rodata.am2_guid_game_property)) KEEP(*(.data.am2_guid_game_property))
    KEEP(*(.origdat.c007))
    KEEP(*(.rodata.am2_app_guid)) KEEP(*(.data.am2_app_guid))
    KEEP(*(.origdat.c008))
    KEEP(*(.rodata.am2_dbl_zero)) KEEP(*(.data.am2_dbl_zero))
    KEEP(*(.rodata.am2_float_zero)) KEEP(*(.data.am2_float_zero))
    KEEP(*(.rodata.am2_flt_230)) KEEP(*(.data.am2_flt_230))
    KEEP(*(.origdat.c009))
    KEEP(*(.rodata.am2_hud_slide_shut)) KEEP(*(.data.am2_hud_slide_shut))
    KEEP(*(.rodata.am2_hud_slide_open)) KEEP(*(.data.am2_hud_slide_open))
    KEEP(*(.origdat.c010))
    KEEP(*(.rodata.am2_dbl_0p7)) KEEP(*(.data.am2_dbl_0p7))
    KEEP(*(.rodata.am2_ms_to_sec)) KEEP(*(.data.am2_ms_to_sec))
    KEEP(*(.origdat.c011))
    KEEP(*(.rodata.am2_dbl_max_period)) KEEP(*(.data.am2_dbl_max_period))
    KEEP(*(.rodata.am2_dbl_ms_per_sec)) KEEP(*(.data.am2_dbl_ms_per_sec))
    KEEP(*(.rodata.am2_dbl_consts_a)) KEEP(*(.data.am2_dbl_consts_a))
    KEEP(*(.rodata.am2_dbl_512)) KEEP(*(.data.am2_dbl_512))
    KEEP(*(.rodata.am2_dbl_sin_scale)) KEEP(*(.data.am2_dbl_sin_scale))
    KEEP(*(.rodata.am2_dbl_one_256)) KEEP(*(.data.am2_dbl_one_256))
    KEEP(*(.rodata.am2_dbl_two_pi)) KEEP(*(.data.am2_dbl_two_pi))
    KEEP(*(.origdat.c012))
    KEEP(*(.rodata.am2_dbl_1_5)) KEEP(*(.data.am2_dbl_1_5))
    KEEP(*(.rodata.am2_dbl_32)) KEEP(*(.data.am2_dbl_32))
    KEEP(*(.rodata.am2_roach_reach)) KEEP(*(.data.am2_roach_reach))
    KEEP(*(.rodata.am2_flt_100_80)) KEEP(*(.data.am2_flt_100_80))
    KEEP(*(.origdat.c013))
    KEEP(*(.rodata.am2_enemy_health_share)) KEEP(*(.data.am2_enemy_health_share))
    KEEP(*(.rodata.am2_fp_consts_b)) KEEP(*(.data.am2_fp_consts_b))
    KEEP(*(.rodata.am2_df_keyboard)) KEEP(*(.data.am2_df_keyboard))
    KEEP(*(.rodata.am2_df_mouse)) KEEP(*(.data.am2_df_mouse))
    KEEP(*(.rodata.am2_guid_null)) KEEP(*(.data.am2_guid_null))
    KEEP(*(.origdat.c014))
    KEEP(*(.rodata.am2_crt_fdiv_num)) KEEP(*(.data.am2_crt_fdiv_num))
    KEEP(*(.rodata.am2_crt_fdiv_den)) KEEP(*(.data.am2_crt_fdiv_den))
    KEEP(*(.rodata.am2_str_isprocessorfeaturepresent)) KEEP(*(.data.am2_str_isprocessorfeaturepresent))
    KEEP(*(.origdat.c015))
    KEEP(*(.rodata.am2_crt_printf_table)) KEEP(*(.data.am2_crt_printf_table))
    KEEP(*(.rodata.am2_crt_wnull_paren)) KEEP(*(.data.am2_crt_wnull_paren))
    KEEP(*(.origdat.c016))
    KEEP(*(.rodata.am2_crt_eh_catch_1)) KEEP(*(.data.am2_crt_eh_catch_1))
    KEEP(*(.rodata.am2_crt_rterr_pool)) KEEP(*(.data.am2_crt_rterr_pool))
    KEEP(*(.origdat.c017))
    KEEP(*(.rodata.am2_crt_rterr_crlf2)) KEEP(*(.data.am2_crt_rterr_crlf2))
    KEEP(*(.origdat.c018))
    KEEP(*(.rodata.am2_crt_rterr_ellipsis)) KEEP(*(.data.am2_crt_rterr_ellipsis))
    KEEP(*(.origdat.c019))
    KEEP(*(.rodata.am2_crt_wday_names)) KEEP(*(.data.am2_crt_wday_names))
    KEEP(*(.origdat.c020))
    KEEP(*(.rodata.am2_crt_month_names)) KEEP(*(.data.am2_crt_month_names))
    KEEP(*(.origdat.c021))
    KEEP(*(.rodata.am2_crt_str_tz)) KEEP(*(.data.am2_crt_str_tz))
    KEEP(*(.origdat.c022))
    KEEP(*(.rodata.am2_crt_eh_catch_2)) KEEP(*(.data.am2_crt_eh_catch_2))
    KEEP(*(.origdat.c023))
    KEEP(*(.rodata.am2_crt_eh_catch_3)) KEEP(*(.data.am2_crt_eh_catch_3))
    KEEP(*(.origdat.c024))
    KEEP(*(.rodata.am2_crt_inittab)) KEEP(*(.data.am2_crt_inittab))
    KEEP(*(.origdat.c025))
    KEEP(*(.rodata.am2_str_newline)) KEEP(*(.data.am2_str_newline))
    KEEP(*(.origdat.c026))
    KEEP(*(.rodata.am2_str_aai_dir)) KEEP(*(.data.am2_str_aai_dir))
    KEEP(*(.rodata.am2_rank_thresholds)) KEEP(*(.data.am2_rank_thresholds))
    KEEP(*(.rodata.am2_rank_records)) KEEP(*(.data.am2_rank_records))
    KEEP(*(.rodata.am2_formation_slots)) KEEP(*(.data.am2_formation_slots))
    KEEP(*(.origdat.c027))
    KEEP(*(.rodata.am2_air_gauge_x0)) KEEP(*(.data.am2_air_gauge_x0))
    KEEP(*(.rodata.am2_air_gauge_y0)) KEEP(*(.data.am2_air_gauge_y0))
    KEEP(*(.rodata.am2_air_gauge_slope)) KEEP(*(.data.am2_air_gauge_slope))
    KEEP(*(.rodata.am2_air_gauge_ms)) KEEP(*(.data.am2_air_gauge_ms))
    KEEP(*(.rodata.am2_air_pass_ms)) KEEP(*(.data.am2_air_pass_ms))
    KEEP(*(.rodata.am2_air_cycle_ms)) KEEP(*(.data.am2_air_cycle_ms))
    KEEP(*(.rodata.am2_air_run_ms)) KEEP(*(.data.am2_air_run_ms))
    KEEP(*(.rodata.am2_air_leg1_ms)) KEEP(*(.data.am2_air_leg1_ms))
    KEEP(*(.rodata.am2_air_leg2_ms)) KEEP(*(.data.am2_air_leg2_ms))
    KEEP(*(.rodata.am2_air_path_in_y)) KEEP(*(.data.am2_air_path_in_y))
    KEEP(*(.rodata.am2_air_path_out_y)) KEEP(*(.data.am2_air_path_out_y))
    KEEP(*(.rodata.am2_air_leg1_slope)) KEEP(*(.data.am2_air_leg1_slope))
    KEEP(*(.rodata.am2_air_leg3_slope)) KEEP(*(.data.am2_air_leg3_slope))
    KEEP(*(.rodata.am2_air_path_mid_y)) KEEP(*(.data.am2_air_path_mid_y))
    KEEP(*(.rodata.am2_air_path_apex_x)) KEEP(*(.data.am2_air_path_apex_x))
    KEEP(*(.rodata.am2_air_path_half_y)) KEEP(*(.data.am2_air_path_half_y))
    KEEP(*(.rodata.am2_air_path_turn_x)) KEEP(*(.data.am2_air_path_turn_x))
    KEEP(*(.rodata.am2_air_path_turn_y_in)) KEEP(*(.data.am2_air_path_turn_y_in))
    KEEP(*(.rodata.am2_air_path_away_x)) KEEP(*(.data.am2_air_path_away_x))
    KEEP(*(.rodata.am2_air_path_turn_y_out)) KEEP(*(.data.am2_air_path_turn_y_out))
    KEEP(*(.rodata.am2_air_drop_offsets)) KEEP(*(.data.am2_air_drop_offsets))
    KEEP(*(.rodata.am2_air_drop_facings)) KEEP(*(.data.am2_air_drop_facings))
    KEEP(*(.origdat.c028))
    KEEP(*(.rodata.am2_air_bit_masks)) KEEP(*(.data.am2_air_bit_masks))
    KEEP(*(.rodata.am2_air_frame_hotspots)) KEEP(*(.data.am2_air_frame_hotspots))
    KEEP(*(.rodata.am2_air_strike_kinds)) KEEP(*(.data.am2_air_strike_kinds))
    KEEP(*(.origdat.c029))
    KEEP(*(.rodata.am2_frame_heading_bias)) KEEP(*(.data.am2_frame_heading_bias))
    KEEP(*(.origdat.c030))
    KEEP(*(.rodata.am2_mode_rb)) KEEP(*(.data.am2_mode_rb))
    KEEP(*(.origdat.c031))
    KEEP(*(.rodata.am2_army_pal_base)) KEEP(*(.data.am2_army_pal_base))
    KEEP(*(.origdat.c032))
    KEEP(*(.rodata.am2_cmdline_movie_flags)) KEEP(*(.data.am2_cmdline_movie_flags))
    KEEP(*(.origdat.c033))
    KEEP(*(.rodata.am2_str_dash_w)) KEEP(*(.data.am2_str_dash_w))
    KEEP(*(.origdat.c034))
    KEEP(*(.rodata.am2_wave_names)) KEEP(*(.data.am2_wave_names))
    KEEP(*(.rodata.am2_voice_groups)) KEEP(*(.data.am2_voice_groups))
    KEEP(*(.origdat.c035))
    KEEP(*(.rodata.am2_weapon_pose_frames)) KEEP(*(.data.am2_weapon_pose_frames))
    KEEP(*(.rodata.am2_pose_by_class)) KEEP(*(.data.am2_pose_by_class))
    KEEP(*(.rodata.am2_death_anim_by_code)) KEEP(*(.data.am2_death_anim_by_code))
    KEEP(*(.rodata.am2_hit_pose_by_class)) KEEP(*(.data.am2_hit_pose_by_class))
    KEEP(*(.rodata.am2_comm_object)) KEEP(*(.data.am2_comm_object))
    KEEP(*(.origdat.c036))
    KEEP(*(.rodata.am2_write_dot_flag)) KEEP(*(.data.am2_write_dot_flag))
    KEEP(*(.rodata.am2_write_dot_record)) KEEP(*(.data.am2_write_dot_record))
    KEEP(*(.rodata.am2_game_version)) KEEP(*(.data.am2_game_version))
    KEEP(*(.rodata.am2_write_dot_float)) KEEP(*(.data.am2_write_dot_float))
    KEEP(*(.origdat.c037))
    KEEP(*(.rodata.am2_str_dot)) KEEP(*(.data.am2_str_dot))
    KEEP(*(.origdat.c038))
    KEEP(*(.rodata.am2_menu_save_slot)) KEEP(*(.data.am2_menu_save_slot))
    KEEP(*(.rodata.am2_hud_commands)) KEEP(*(.data.am2_hud_commands))
    KEEP(*(.rodata.am2_hud_squad_slot_xy)) KEEP(*(.data.am2_hud_squad_slot_xy))
    KEEP(*(.rodata.am2_hud_cmd_offsets)) KEEP(*(.data.am2_hud_cmd_offsets))
    KEEP(*(.rodata.am2_cheat_words)) KEEP(*(.data.am2_cheat_words))
    KEEP(*(.origdat.c039))
    KEEP(*(.rodata.am2_fog_of_war)) KEEP(*(.data.am2_fog_of_war))
    KEEP(*(.rodata.am2_debug_blast_kind)) KEEP(*(.data.am2_debug_blast_kind))
    KEEP(*(.rodata.am2_debug_blast_flag)) KEEP(*(.data.am2_debug_blast_flag))
    KEEP(*(.origdat.c040))
    KEEP(*(.rodata.am2_bool_word_names)) KEEP(*(.data.am2_bool_word_names))
    KEEP(*(.rodata.am2_def_keywords)) KEEP(*(.data.am2_def_keywords))
    KEEP(*(.origdat.c041))
    KEEP(*(.rodata.am2_bool_display_strings)) KEEP(*(.data.am2_bool_display_strings))
    KEEP(*(.origdat.c042))
    KEEP(*(.rodata.am2_str_def_file_mode)) KEEP(*(.data.am2_str_def_file_mode))
    KEEP(*(.origdat.c043))
    KEEP(*(.rodata.am2_active_palette)) KEEP(*(.data.am2_active_palette))
    KEEP(*(.origdat.c044))
    KEEP(*(.rodata.am2_logpalette)) KEEP(*(.data.am2_logpalette))
    KEEP(*(.origdat.c045))
    KEEP(*(.rodata.am2_logpalette_hdr_small)) KEEP(*(.data.am2_logpalette_hdr_small))
    KEEP(*(.rodata.am2_gdi_palette)) KEEP(*(.data.am2_gdi_palette))
    KEEP(*(.rodata.am2_remap_tint)) KEEP(*(.data.am2_remap_tint))
    KEEP(*(.origdat.c046))
    KEEP(*(.rodata.am2_explosion_box)) KEEP(*(.data.am2_explosion_box))
    KEEP(*(.rodata.am2_explosion_area_16)) KEEP(*(.data.am2_explosion_area_16))
    KEEP(*(.rodata.am2_explosion_area_24)) KEEP(*(.data.am2_explosion_area_24))
    KEEP(*(.rodata.am2_explosion_area_32)) KEEP(*(.data.am2_explosion_area_32))
    KEEP(*(.rodata.am2_explosion_row_spec)) KEEP(*(.data.am2_explosion_row_spec))
    KEEP(*(.origdat.c047))
    KEEP(*(.rodata.am2_opt_df)) KEEP(*(.data.am2_opt_df))
    KEEP(*(.origdat.c048))
    KEEP(*(.rodata.am2_aim_displace_map)) KEEP(*(.data.am2_aim_displace_map))
    KEEP(*(.origdat.c049))
    KEEP(*(.rodata.am2_tick_interval_ms)) KEEP(*(.data.am2_tick_interval_ms))
    KEEP(*(.rodata.am2_dir_defaults)) KEEP(*(.data.am2_dir_defaults))
    KEEP(*(.origdat.c050))
    KEEP(*(.rodata.am2_str_tan)) KEEP(*(.data.am2_str_tan))
    KEEP(*(.origdat.c051))
    KEEP(*(.rodata.am2_mode_wb)) KEEP(*(.data.am2_mode_wb))
    KEEP(*(.origdat.c052))
    KEEP(*(.rodata.am2_str_fmt_s)) KEEP(*(.data.am2_str_fmt_s))
    KEEP(*(.origdat.c053))
    KEEP(*(.rodata.am2_dir_names)) KEEP(*(.data.am2_dir_names))
    KEEP(*(.rodata.am2_screen_w)) KEEP(*(.data.am2_screen_w))
    KEEP(*(.rodata.am2_screen_h)) KEEP(*(.data.am2_screen_h))
    KEEP(*(.rodata.am2_view_speed)) KEEP(*(.data.am2_view_speed))
    KEEP(*(.rodata.am2_screen_consts)) KEEP(*(.data.am2_screen_consts))
    KEEP(*(.rodata.am2_gravity)) KEEP(*(.data.am2_gravity))
    KEEP(*(.origdat.c054))
    KEEP(*(.rodata.am2_edit_charset_default)) KEEP(*(.data.am2_edit_charset_default))
    KEEP(*(.rodata.am2_edit_charset_ptr)) KEEP(*(.data.am2_edit_charset_ptr))
    KEEP(*(.origdat.c055))
    KEEP(*(.rodata.am2_screen_geom)) KEEP(*(.data.am2_screen_geom))
    KEEP(*(.rodata.am2_spiral_step)) KEEP(*(.data.am2_spiral_step))
    KEEP(*(.rodata.am2_edit_charset)) KEEP(*(.data.am2_edit_charset))
    KEEP(*(.origdat.c056))
    KEEP(*(.rodata.am2_mouse_state)) KEEP(*(.data.am2_mouse_state))
    KEEP(*(.rodata.am2_key_bindings)) KEEP(*(.data.am2_key_bindings))
    KEEP(*(.rodata.am2_key_action_defaults)) KEEP(*(.data.am2_key_action_defaults))
    KEEP(*(.rodata.am2_diprop_buffer_size)) KEEP(*(.data.am2_diprop_buffer_size))
    KEEP(*(.origdat.c057))
    KEEP(*(.rodata.am2_str_unique_suffix)) KEEP(*(.data.am2_str_unique_suffix))
    KEEP(*(.origdat.c058))
    KEEP(*(.rodata.am2_map_field_descs)) KEEP(*(.data.am2_map_field_descs))
    KEEP(*(.origdat.c059))
    KEEP(*(.rodata.am2_map_field_tables)) KEEP(*(.data.am2_map_field_tables))
    KEEP(*(.rodata.am2_palette_cycle_seq)) KEEP(*(.data.am2_palette_cycle_seq))
    KEEP(*(.rodata.am2_palette_cycle_index)) KEEP(*(.data.am2_palette_cycle_index))
    KEEP(*(.rodata.am2_palette_cycle_count)) KEEP(*(.data.am2_palette_cycle_count))
    KEEP(*(.rodata.am2_palette_cycle_interval)) KEEP(*(.data.am2_palette_cycle_interval))
    KEEP(*(.rodata.am2_palette_cycle_extra)) KEEP(*(.data.am2_palette_cycle_extra))
    KEEP(*(.rodata.am2_shake_presets)) KEEP(*(.data.am2_shake_presets))
    KEEP(*(.origdat.c060))
    KEEP(*(.rodata.am2_pad_bit_table)) KEEP(*(.data.am2_pad_bit_table))
    KEEP(*(.rodata.am2_state_actions)) KEEP(*(.data.am2_state_actions))
    KEEP(*(.rodata.am2_str_movie_its)) KEEP(*(.data.am2_str_movie_its))
    KEEP(*(.rodata.am2_str_movie_3do)) KEEP(*(.data.am2_str_movie_3do))
    KEEP(*(.origdat.c061))
    KEEP(*(.rodata.am2_str_movie_sml)) KEEP(*(.data.am2_str_movie_sml))
    KEEP(*(.origdat.c062))
    KEEP(*(.rodata.am2_option_table)) KEEP(*(.data.am2_option_table))
    KEEP(*(.origdat.c063))
    KEEP(*(.rodata.am2_str_open_slot)) KEEP(*(.data.am2_str_open_slot))
    KEEP(*(.origdat.c064))
    KEEP(*(.rodata.am2_str_computer_slot)) KEEP(*(.data.am2_str_computer_slot))
    KEEP(*(.origdat.c065))
    KEEP(*(.rodata.am2_kind7_box)) KEEP(*(.data.am2_kind7_box))
    KEEP(*(.origdat.c066))
    KEEP(*(.rodata.am2_bit_from_n)) KEEP(*(.data.am2_bit_from_n))
    KEEP(*(.rodata.am2_region_search_state)) KEEP(*(.data.am2_region_search_state))
    KEEP(*(.rodata.am2_path_resume)) KEEP(*(.data.am2_path_resume))
    KEEP(*(.rodata.am2_spiral_dx)) KEEP(*(.data.am2_spiral_dx))
    KEEP(*(.rodata.am2_spiral_dy)) KEEP(*(.data.am2_spiral_dy))
    KEEP(*(.rodata.am2_spiral_path_const)) KEEP(*(.data.am2_spiral_path_const))
    KEEP(*(.rodata.am2_path_max_nodes)) KEEP(*(.data.am2_path_max_nodes))
    KEEP(*(.rodata.am2_path_max_searches)) KEEP(*(.data.am2_path_max_searches))
    KEEP(*(.rodata.am2_path_retry_ms)) KEEP(*(.data.am2_path_retry_ms))
    KEEP(*(.rodata.am2_unit_types)) KEEP(*(.data.am2_unit_types))
    KEEP(*(.origdat.c067))
    KEEP(*(.rodata.am2_missile_box)) KEEP(*(.data.am2_missile_box))
    KEEP(*(.rodata.am2_missile_row_spec)) KEEP(*(.data.am2_missile_row_spec))
    KEEP(*(.origdat.c068))
    KEEP(*(.rodata.am2_roach)) KEEP(*(.data.am2_roach))
    KEEP(*(.origdat.c069))
    KEEP(*(.rodata.am2_name_score_vars)) KEEP(*(.data.am2_name_score_vars))
    KEEP(*(.rodata.am2_script_kind_names)) KEEP(*(.data.am2_script_kind_names))
    KEEP(*(.origdat.c070))
    KEEP(*(.rodata.am2_script_unknown_str)) KEEP(*(.data.am2_script_unknown_str))
    KEEP(*(.origdat.c071))
    KEEP(*(.rodata.am2_sprite_set_dirs)) KEEP(*(.data.am2_sprite_set_dirs))
    KEEP(*(.origdat.c072))
    KEEP(*(.rodata.am2_font_descs)) KEEP(*(.data.am2_font_descs))
    KEEP(*(.origdat.c073))
    KEEP(*(.rodata.am2_str_fmt_c)) KEEP(*(.data.am2_str_fmt_c))
    KEEP(*(.origdat.c074))
    KEEP(*(.rodata.am2_trooper_class_value)) KEEP(*(.data.am2_trooper_class_value))
    KEEP(*(.rodata.am2_trooper_box)) KEEP(*(.data.am2_trooper_box))
    KEEP(*(.rodata.am2_trooper_row_spec)) KEEP(*(.data.am2_trooper_row_spec))
    KEEP(*(.rodata.am2_difficulty_scale)) KEEP(*(.data.am2_difficulty_scale))
    KEEP(*(.origdat.c075))
    KEEP(*(.rodata.am2_weapon_handlers)) KEEP(*(.data.am2_weapon_handlers))
    KEEP(*(.rodata.am2_unit_name_sarge)) KEEP(*(.data.am2_unit_name_sarge))
    KEEP(*(.rodata.am2_unit_class_names)) KEEP(*(.data.am2_unit_class_names))
    KEEP(*(.rodata.am2_soldier_names)) KEEP(*(.data.am2_soldier_names))
    KEEP(*(.rodata.am2_drop_ring)) KEEP(*(.data.am2_drop_ring))
    KEEP(*(.rodata.am2_step_facing_sweep)) KEEP(*(.data.am2_step_facing_sweep))
    KEEP(*(.origdat.c076))
    KEEP(*(.rodata.am2_key_defaults)) KEEP(*(.data.am2_key_defaults))
    KEEP(*(.rodata.am2_movie_names)) KEEP(*(.data.am2_movie_names))
    KEEP(*(.rodata.am2_keyrow_positions)) KEEP(*(.data.am2_keyrow_positions))
    KEEP(*(.origdat.c077))
    KEEP(*(.rodata.am2_key_names)) KEEP(*(.data.am2_key_names))
    KEEP(*(.origdat.c078))
    KEEP(*(.rodata.am2_str_any_file)) KEEP(*(.data.am2_str_any_file))
    KEEP(*(.origdat.c079))
    KEEP(*(.rodata.am2_str_glob_all)) KEEP(*(.data.am2_str_glob_all))
    KEEP(*(.origdat.c080))
    KEEP(*(.rodata.am2_str_line_break)) KEEP(*(.data.am2_str_line_break))
    KEEP(*(.origdat.c081))
    KEEP(*(.rodata.am2_slot_recs)) KEEP(*(.data.am2_slot_recs))
    KEEP(*(.origdat.c082))
    KEEP(*(.rodata.am2_vehicle_height_by_kind)) KEEP(*(.data.am2_vehicle_height_by_kind))
    KEEP(*(.rodata.am2_vehicle_box)) KEEP(*(.data.am2_vehicle_box))
    KEEP(*(.rodata.am2_vehicle_row_spec)) KEEP(*(.data.am2_vehicle_row_spec))
    KEEP(*(.rodata.am2_kind_frames)) KEEP(*(.data.am2_kind_frames))
    KEEP(*(.rodata.am2_vehicle_names)) KEEP(*(.data.am2_vehicle_names))
    KEEP(*(.origdat.c083))
    KEEP(*(.rodata.am2_item_type_offsets)) KEEP(*(.data.am2_item_type_offsets))
    KEEP(*(.rodata.am2_item_type_names)) KEEP(*(.data.am2_item_type_names))
    KEEP(*(.rodata.am2_respawn_kind_mask)) KEEP(*(.data.am2_respawn_kind_mask))
    KEEP(*(.origdat.c084))
    KEEP(*(.rodata.am2_mp_row_coords)) KEEP(*(.data.am2_mp_row_coords))
    KEEP(*(.rodata.am2_mp_pause_bits_a)) KEEP(*(.data.am2_mp_pause_bits_a))
    KEEP(*(.rodata.am2_mp_pause_bits_b)) KEEP(*(.data.am2_mp_pause_bits_b))
    KEEP(*(.rodata.am2_mp_pause_bits_c)) KEEP(*(.data.am2_mp_pause_bits_c))
    KEEP(*(.rodata.am2_info_overlay_on)) KEEP(*(.data.am2_info_overlay_on))
    KEEP(*(.origdat.c085))
    KEEP(*(.rodata.am2_sprite_groups)) KEEP(*(.data.am2_sprite_groups))
    KEEP(*(.rodata.am2_sprite_group_b)) KEEP(*(.data.am2_sprite_group_b))
    KEEP(*(.rodata.am2_sprite_grid_rows)) KEEP(*(.data.am2_sprite_grid_rows))
    KEEP(*(.rodata.am2_sprite_grid_cols)) KEEP(*(.data.am2_sprite_grid_cols))
    KEEP(*(.rodata.am2_sprite_grid)) KEEP(*(.data.am2_sprite_grid))
    KEEP(*(.rodata.am2_sprite_grid_data)) KEEP(*(.data.am2_sprite_grid_data))
    KEEP(*(.rodata.am2_seq_grid_rows)) KEEP(*(.data.am2_seq_grid_rows))
    KEEP(*(.rodata.am2_seq_variant_stride)) KEEP(*(.data.am2_seq_variant_stride))
    KEEP(*(.rodata.am2_seq_tail_frames)) KEEP(*(.data.am2_seq_tail_frames))
    KEEP(*(.rodata.am2_seq_advance_ms)) KEEP(*(.data.am2_seq_advance_ms))
    KEEP(*(.rodata.am2_seq_sprites_7)) KEEP(*(.data.am2_seq_sprites_7))
    KEEP(*(.origdat.c086))
    KEEP(*(.rodata.am2_decal_sprites)) KEEP(*(.data.am2_decal_sprites))
    KEEP(*(.rodata.am2_decal_sprite_count)) KEEP(*(.data.am2_decal_sprite_count))
    KEEP(*(.rodata.am2_seq_sprites_5)) KEEP(*(.data.am2_seq_sprites_5))
    KEEP(*(.rodata.am2_seq_sprite_5_count)) KEEP(*(.data.am2_seq_sprite_5_count))
    KEEP(*(.rodata.am2_mark_sprites)) KEEP(*(.data.am2_mark_sprites))
    KEEP(*(.rodata.am2_mark_sprite_count)) KEEP(*(.data.am2_mark_sprite_count))
    KEEP(*(.rodata.am2_mp_mark_grid)) KEEP(*(.data.am2_mp_mark_grid))
    KEEP(*(.rodata.am2_mp_mark_cols)) KEEP(*(.data.am2_mp_mark_cols))
    KEEP(*(.rodata.am2_seq_k4_step_ms)) KEEP(*(.data.am2_seq_k4_step_ms))
    KEEP(*(.rodata.am2_seq_k4_hold)) KEEP(*(.data.am2_seq_k4_hold))
    KEEP(*(.rodata.am2_seq_k4_drift_x)) KEEP(*(.data.am2_seq_k4_drift_x))
    KEEP(*(.rodata.am2_seq_k4_drift_y)) KEEP(*(.data.am2_seq_k4_drift_y))
    KEEP(*(.rodata.am2_seq_k4_rise)) KEEP(*(.data.am2_seq_k4_rise))
    KEEP(*(.origdat.c087))
    KEEP(*(.rodata.am2_seq_emit_ms)) KEEP(*(.data.am2_seq_emit_ms))
    KEEP(*(.origdat.c088))
    KEEP(*(.rodata.am2_rand_seed)) KEEP(*(.data.am2_rand_seed))
    KEEP(*(.rodata.am2_crt_osver_pair)) KEEP(*(.data.am2_crt_osver_pair))
    KEEP(*(.rodata.am2_crt_fpinit_ptr)) KEEP(*(.data.am2_crt_fpinit_ptr))
    KEEP(*(.rodata.am2_str_udf_pair)) KEEP(*(.data.am2_str_udf_pair))
    KEEP(*(.rodata.am2_crt_eh_magic)) KEEP(*(.data.am2_crt_eh_magic))
    KEEP(*(.origdat.c089))
    KEEP(*(.rodata.am2_crt_exit_fn_ptr)) KEEP(*(.data.am2_crt_exit_fn_ptr))
    KEEP(*(.rodata.am2_crt_app_type)) KEEP(*(.data.am2_crt_app_type))
    KEEP(*(.rodata.am2_crt_sig_handlers_a)) KEEP(*(.data.am2_crt_sig_handlers_a))
    KEEP(*(.rodata.am2_crt_sbh_threshold)) KEEP(*(.data.am2_crt_sbh_threshold))
    KEEP(*(.rodata.am2_crt_sig_handlers_b)) KEEP(*(.data.am2_crt_sig_handlers_b))
    KEEP(*(.rodata.am2_crt_nullstring)) KEEP(*(.data.am2_crt_nullstring))
    KEEP(*(.rodata.am2_crt_wnullstring)) KEEP(*(.data.am2_crt_wnullstring))
    KEEP(*(.rodata.am2_crt_badioinfo)) KEEP(*(.data.am2_crt_badioinfo))
    KEEP(*(.rodata.am2_crt_pctype)) KEEP(*(.data.am2_crt_pctype))
    KEEP(*(.rodata.am2_crt_pctype_alias)) KEEP(*(.data.am2_crt_pctype_alias))
    KEEP(*(.rodata.am2_crt_ctype)) KEEP(*(.data.am2_crt_ctype))
    KEEP(*(.origdat.c090))
    KEEP(*(.rodata.am2_crt_mb_cur_max)) KEEP(*(.data.am2_crt_mb_cur_max))
    KEEP(*(.rodata.am2_crt_decimal_point)) KEEP(*(.data.am2_crt_decimal_point))
    KEEP(*(.origdat.c091))
    KEEP(*(.rodata.am2_crt_one)) KEEP(*(.data.am2_crt_one))
    KEEP(*(.rodata.am2_crt_huge_val)) KEEP(*(.data.am2_crt_huge_val))
    KEEP(*(.rodata.am2_crt_flt_ptr)) KEEP(*(.data.am2_crt_flt_ptr))
    KEEP(*(.origdat.c092))
    KEEP(*(.rodata.am2_crt_iob)) KEEP(*(.data.am2_crt_iob))
    KEEP(*(.rodata.am2_crt_errtable)) KEEP(*(.data.am2_crt_errtable))
    KEEP(*(.origdat.c093))
    KEEP(*(.rodata.am2_crt_xcpt_tables)) KEEP(*(.data.am2_crt_xcpt_tables))
    KEEP(*(.rodata.am2_crt_rterr_table)) KEEP(*(.data.am2_crt_rterr_table))
    KEEP(*(.rodata.am2_crt_cvtinfo_double)) KEEP(*(.data.am2_crt_cvtinfo_double))
    KEEP(*(.origdat.c094))
    KEEP(*(.rodata.am2_crt_tz_state)) KEEP(*(.data.am2_crt_tz_state))
    KEEP(*(.rodata.am2_tzname_std)) KEEP(*(.data.am2_tzname_std))
    KEEP(*(.rodata.am2_tzname_dst)) KEEP(*(.data.am2_tzname_dst))
    KEEP(*(.rodata.am2_crt_tzname)) KEEP(*(.data.am2_crt_tzname))
    KEEP(*(.origdat.c095))
    KEEP(*(.rodata.am2_crt_dst_start)) KEEP(*(.data.am2_crt_dst_start))
    KEEP(*(.origdat.c096))
    KEEP(*(.rodata.am2_crt_dst_end)) KEEP(*(.data.am2_crt_dst_end))
    KEEP(*(.rodata.am2_crt_lpdays)) KEEP(*(.data.am2_crt_lpdays))
    KEEP(*(.rodata.am2_crt_days)) KEEP(*(.data.am2_crt_days))
    KEEP(*(.origdat.c097))
    KEEP(*(.rodata.am2_crt_mbctype_range_flags)) KEEP(*(.data.am2_crt_mbctype_range_flags))
    KEEP(*(.rodata.am2_crt_mbcp_table)) KEEP(*(.data.am2_crt_mbcp_table))
    KEEP(*(.rodata.am2_crt_pow10_table)) KEEP(*(.data.am2_crt_pow10_table))
    KEEP(*(.rodata.am2_crt_pow10_neg_table)) KEEP(*(.data.am2_crt_pow10_neg_table))
    KEEP(*(.rodata.am2_comm_block)) KEEP(*(.data.am2_comm_block))
  }
} INSERT AFTER .bss;
